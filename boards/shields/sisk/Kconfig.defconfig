## boards/shields/sisk/Kconfig.defconfig
```kconfig
if SHIELD_SISK_LEFT

# Name must be less than 16 characters long!
config ZMK_KEYBOARD_NAME
    default "sisk"

config ZMK_SPLIT_ROLE_CENTRAL
    default y

endif

if SHIELD_SISK_LEFT || SHIELD_SISK_RIGHT

config ZMK_SPLIT
    default y

endif

config I2C
    default y

config SSD1306
    default y

endif # ZMK_DISPLAY

#if LVGL

#config LV_Z_VDB_SIZE
#    default 64

#config LV_DPI_DEF
#    default 148

#config LV_Z_BITS_PER_PIXEL
    dLVefault 1

#choice LV_COLOR_DEPTH
#    default LV_COLOR_DEPTH_1
#endchoice

#endif # LVGL

#endif
```
